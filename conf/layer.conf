## conf/layer.conf
```bitbake
#
# Copyright (C) 2024 Wind River Systems, Inc.
#

# We have a conf and classes directory, add to BBPATH
BBPATH =. "${LAYERDIR}:"

# We have a packages directory, add to BBFILES
BBFILES += "${LAYERDIR}/recipes-*/*/*.bb \
	${LAYERDIR}/recipes-*/*/*.bbappend"

BBFILE_COLLECTIONS += "wr-intel-grand-ridge"
BBFILE_PATTERN_wr-intel-grand-ridge = "^${LAYERDIR}/"
BBFILE_PRIORITY_wr-intel-grand-ridge = "8"

LAYERVERSION_wr-intel-grand-ridge = "1"

LAYERDEPENDS_wr-intel-grand-ridge = "core wrlinux intel intel-x86"

LAYERSERIES_COMPAT_wr-intel-grand-ridge = "wrl mickledore"

LAYER_PATH_wr-intel-grand-ridge = "${LAYERDIR}"
```

## conf/machine/include/tune-grandridge.inc
```bitbake
DEFAULTTUNE ??= "grandridge-64"

require conf/machine/include/x86/tune-corei7.inc

TUNEVALID[grandridge] = "Enable Grand Ridge specific processor optimizations"

TUNE_CCARGS .= "${@bb.utils.contains("TUNE_FEATURES", "grandridge", " -march=grandridge -mfpmath=sse", "", d)}"

AVAILTUNES += "grandridge-32 grandridge-64"
TUNE_FEATURES:tune-grandridge-32 = "${TUNE_FEATURES:tune-x86} grandridge"
TUNE_FEATURES:tune-grandridge-64 = "${TUNE_FEATURES:tune-x86-64} grandridge"

BASE_LIB:tune-grandridge-32 = "lib"
BASE_LIB:tune-grandridge-64 = "lib64"

TUNE_PKGARCH:tune-grandridge-32 = "grandridge-32"
TUNE_PKGARCH:tune-grandridge-64 = "grandridge-64"

PACKAGE_EXTRA_ARCHS:tune-grandridge-32 = "${PACKAGE_EXTRA_ARCHS:tune-x86} grandridge-32"
PACKAGE_EXTRA_ARCHS:tune-grandridge-64 = "${PACKAGE_EXTRA_ARCHS:tune-x86-64} grandridge-64"
```

## conf/machine/intel-grand-ridge.conf
```bitbake
#
# Copyright (C) 2024 Wind River Systems, Inc.
#
#@TYPE: Machine
#@NAME: intel-grand-ridge
#@DESCRIPTION: Machine configuration for Intel Grand Ridge

DEFAULTTUNE ?= "grandridge-64"
require conf/machine/include/tune-grandridge.inc
require conf/machine/intel-x86.inc

# multilib support
MULTILIBS ?= "multilib:lib32"
DEFAULTTUNE:virtclass-multilib-lib32 ?= "grandridge-32"

SERIAL_CONSOLES = "115200;ttyS4"

# wks file for Intel Grand Ridge
WKS_FILE = "intel-grandridge-mkefidisk.wks.in"

# When using Intel Grand Ridge machine specific tune flags, some packages are
# not compatible with some x86 instruction sets in 32-bit multilib build.
TUNE_CCARGS:append:pn-lib32-rocksdb = "${@bb.utils.contains('TUNE_FEATURES', 'grandridge', ' -mno-avx -mno-avx2 -mno-bmi -mno-bmi2 -mno-pclmul', '', d)}"
TUNE_CCARGS:append:pn-lib32-grpc = "${@bb.utils.contains('TUNE_FEATURES', 'grandridge', ' -mno-bmi -mno-bmi2', '', d)}"
TUNE_CCARGS:append:pn-lib32-python3-grpcio = "${@bb.utils.contains('TUNE_FEATURES', 'grandridge', ' -mno-bmi -mno-bmi2', '', d)}"
TUNE_CCARGS:append:pn-lib32-python3-mldtypes = "${@bb.utils.contains('TUNE_FEATURES', 'grandridge', ' -mno-avx -mno-avx2', '', d)}"

# kexec-tools don't work with AVX, so disable it when using grandridge tune feature.
TUNE_CCARGS:append:pn-kexec-tools = "${@bb.utils.contains('TUNE_FEATURES', 'grandridge', ' -mno-avx -mno-avx2', '', d)}"
```
